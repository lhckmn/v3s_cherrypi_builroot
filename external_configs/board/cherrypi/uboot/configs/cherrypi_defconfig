## external_configs/board/cherrypi/uboot/configs/cherrypi_defconfig
```kconfig
CONFIG_ARM=y
CONFIG_ARCH_SUNXI=y
CONFIG_DEFAULT_DEVICE_TREE="sun8i-v3s-cherrypi"
CONFIG_SPL=y
CONFIG_MACH_SUN8I_V3S=y
CONFIG_DRAM_CLK=360
# CONFIG_HAS_ARMV7_SECURE_BASE is not set
CONFIG_NO_NET=y

CONFIG_VIDEO=y
CONFIG_VIDEO_SUNXI=y
CONFIG_VIDEO_DE2=y
CONFIG_VIDEO_SIMPLE=y
CONFIG_VIDEO_DT_SIMPLEFB=y

CONFIG_BACKLIGHT_GPIO=y
```
